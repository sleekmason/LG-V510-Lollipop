## kernel/arch/arm/mach-msm/lge/Kconfig.board
```kconfig
#
# Inlcude the specific Kconfig file for LGE board
#
# MAKO
source "arch/arm/mach-msm/lge/mako/Kconfig"

# PALMAN
source "arch/arm/mach-msm/lge/palman/Kconfig"

config MACH_LGE_DUMMY
	bool "NONE (No device)"
```

## kernel/arch/arm/mach-msm/lge/palman/Kconfig
```kconfig
config BOARD_HEADER_FILE
	string "LGE board specific header file name"
	default ""

config MACH_APQ8064_PALMAN
	depends on ARCH_APQ8064
	select MACH_LGE
	bool "APQ8064 Palman Device"
	help
	  Support for the LGE Palman device.
```
